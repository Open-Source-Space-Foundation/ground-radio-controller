/*
 * SPDX-License-Identifier: Apache-2.0
 */

/dts-v1/;

#include <raspberrypi/rpi_pico/rp2350a.dtsi>
#include <raspberrypi/rpi_pico/m33.dtsi>
#include <../boards/raspberrypi/rpi_pico2/rpi_pico2.dtsi>
#include <../boards/raspberrypi/common/rpi_pico-led.dtsi>
#include "proves_radio_stick_v2_hardware.dtsi"
