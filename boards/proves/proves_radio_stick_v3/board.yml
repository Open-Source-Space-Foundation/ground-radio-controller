## boards/proves/proves_radio_stick_v3/board.yml
```yaml
# SPDX-License-Identifier: Apache-2.0

board:
  name: proves_radio_stick_v3
  full_name: PROVES Radio Stick V3
  vendor: PROVES
  socs:
    - name: stm32u575xx
```

## west.yml
```yaml
# West manifest for PROVES Core - Optimized for RP2040/RP2350 only
# This minimal manifest significantly reduces the download and setup time
# by only including modules required for Raspberry Pi RP2040/RP2350 builds

manifest:
  defaults:
    remote: upstream

  remotes:
    - name: upstream
      url-base: https://github.com/zephyrproject-rtos

  # Import filter to exclude optional groups
  group-filter: [-babblesim, -optional]

  projects:
    # Zephyr RTOS core
    - name: zephyr
      repo-path: zephyr
      revision: v4.5.0
      path: lib/zephyr-workspace/zephyr
      west-commands: scripts/west-commands.yml
      import:
        # Import specific submanifests only (instead of all submanifests)
        name-allowlist:
          - cmsis      # ARM CMSIS support (required for Cortex-M)
          - cmsis_6    # ARM CMSIS 6 support (required for RPI)
          - hal_rpi_pico  # Raspberry Pi Pico HAL (REQUIRED for RP2040/RP2350)
          - picolibc   # C library
          - mbedtls    # Crypto library
          - tinycrypt  # Lightweight crypto library
          - mcuboot    # Bootloader support
          - hal_st     # Required for certain sensors
          - segger     # SEGGER RTT support

    - name: loramac-node
      revision: 874544f2a8a0212a0cc12e5eea51a024fd3d93d1
      path: lib/zephyr-workspace/modules/lib/loramac-node

    # Core modules required for RP2040/RP2350
    - name: cmsis
      revision: 512cc7e895e8491696b61f7ba8066b4a182569b8
      path: lib/zephyr-workspace/modules/hal/cmsis
      groups:
        - hal

    - name: cmsis_6
      repo-path: CMSIS_6
      revision: 1c1840af7a7e757d6e2fec3ddb0e5ce0dfcc93c8
      path: lib/zephyr-workspace/modules/hal/cmsis_6
      groups:
        - hal

    - name: hal_rpi_pico
      path: lib/zephyr-workspace/modules/hal/rpi_pico
      revision: 2e9dbf14fa56e5907aefb07e8e75010ec5210946
      groups:
        - hal

    - name: hal_st
      revision: ce795a9b0de623022c17d2ff394587c024aec850
      path: lib/zephyr-workspace/modules/hal/st
      groups:
        - hal

    - name: hal_stm32
      revision: c9550199186236d610092f4005f8c9bae2a6bfcf
      path: lib/zephyr-workspace/modules/hal/stm32
      groups:
        - hal

    - name: picolibc
      path: lib/zephyr-workspace/modules/lib/picolibc
      revision: 01254932e8e81085817ed61fd858648584ffe37c

    # Crypto libraries (commonly used)
    - name: mbedtls
      revision: c43f34b93797e81fd0257c30004dcd0ae332ae51
      path: lib/zephyr-workspace/modules/crypto/mbedtls
      groups:
        - crypto

    - name: tinycrypt
      revision: 1012a3ebee18c15ede5efc8332ee2fc37817670f
      path: lib/zephyr-workspace/modules/crypto/tinycrypt
      groups:
        - crypto

    - name: mcuboot
      revision: 725d63c9d5bc1bb572d802e7a768daf504186daf
      path: lib/zephyr-workspace/bootloader/mcuboot

    - name: segger
      revision: 50892fdbcf2f570e67baa72b8894a66b16946f72
      path: lib/zephyr-workspace/modules/debug/segger
      groups:
        - debug

  self:
    path: .
    west-commands: west-commands.yml
```
