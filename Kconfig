## boards/proves/ground_radio_controller/Kconfig
```kconfig
# SPDX-License-Identifier: Apache-2.0

config BOARD_GROUND_RADIO_CONTROLLER
	select SOC_RP2350A_M33 if BOARD_GROUND_RADIO_CONTROLLER_RP2350A_M33
```

## boards/proves/proves_flight_control_board_v5/Kconfig
```kconfig
# SPDX-License-Identifier: Apache-2.0

config BOARD_PROVES_FLIGHT_CONTROL_BOARD_V5
	select SOC_RP2350A_M33 if BOARD_PROVES_FLIGHT_CONTROL_BOARD_V5_RP2350A_M33
```

## boards/proves/proves_flight_control_board_v5e/Kconfig
```kconfig
# SPDX-License-Identifier: Apache-2.0

config BOARD_PROVES_FLIGHT_CONTROL_BOARD_V5E
	select SOC_RP2350A_M33 if BOARD_PROVES_FLIGHT_CONTROL_BOARD_V5E_RP2350A_M33
```

## boards/proves/proves_radio_stick_v2/Kconfig
```kconfig
# SPDX-License-Identifier: Apache-2.0

config BOARD_PROVES_RADIO_STICK_V2
	select SOC_RP2350A_M33 if BOARD_PROVES_RADIO_STICK_V2_RP2350A_M33
```

## boards/proves/proves_radio_stick_v2/board.yml
```yaml
# SPDX-License-Identifier: Apache-2.0

board:
  name: proves_radio_stick_v2
  full_name: PROVES Radio Stick V2
  vendor: PROVES
  socs:
    - name: rp2350a
```
